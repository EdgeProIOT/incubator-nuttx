## boards/arm/imxrt/edgepro1/Kconfig
```kconfig
#
# For a description of the syntax of this configuration file,
# see the file kconfig-language.txt in the NuttX tools repository.
#

if ARCH_BOARD_EDGEPRO1

choice
	prompt "Boot Flash"
	default EDGEPRO1_QSPI_FLASH

config EDGEPRO1_QSPI_FLASH
	bool "QSPI Flash"

endchoice # Boot Flash

endif
```

## boards/arm/imxrt/imxrt1064-evk/Kconfig
```kconfig
#
# For a description of the syntax of this configuration file,
# see the file kconfig-language.txt in the NuttX tools repository.
#

if ARCH_BOARD_IMXRT1064_EVK

choice
	prompt "Boot Flash"
	default IMXRT1064_EVK_QSPI_FLASH

config IMXRT1064_EVK_HYPER_FLASH
	bool "HYPER Flash"

config IMXRT1064_EVK_QSPI_FLASH
	bool "QSPI Flash"

endchoice # Boot Flash

config IMXRT1064_EVK_SDRAM
	bool "Enable SDRAM"
	default n
	select IMXRT_SEMC_INIT_DONE
	---help---
		Activate DCD configuration of SDRAM

config IMXRT_ADS1278
	bool "Enable ADS1278 device"
	default n
	select IMXRT_FLEXIO
	select IMXRT_EDMA
	---help---
		Activate ADS1278 device

if IMXRT_ADS1278

config ADS1278_FIFOSIZE
	int "ADS1278 FIFO size"
	default 64
	---help---
		This variable defines the size of the ADS1278 ring buffer that is used
		to queue received ADS1278 data until they can be retrieved by the
		application by reading from the ADS character device.  NOTE:  Since
		this is a ring buffer, the actual number of bytes that can be
		retained in buffer is (ADS1278_FIFOSIZE - 1).

config ADS1278_NPOLLWAITERS
	int "Number of poll waiters"
	default 2
	---help---
		Maximum number of threads that can be waiting on poll.

endif # IMXRT_ADS1278

endif
```

## drivers/wireless/esp-hosted/Kconfig
```kconfig
#
# For a description of the syntax of this configuration file,
# see the file kconfig-language.txt in the NuttX tools repository.
#

config ESP_HOSTED
	bool "ESP-Hosted"
	default n
	select SPI
	---help---
		Enable support for the ESP-Hosted

if ESP_HOSTED

config ESP_HOSTED_SPIFREQUENCY
	int "ESP_Hosted SPI frequency"
	default 10000000
	---help---
		Frequency at which to operate the SPI interface to the ESP part.
		The default is the absolute maximum and you may likely have to
		reduce this for your board.

choice
	prompt "ESP-Hosted Wi-Fi mode"
	default ESP_HOSTED_WIFI_STATION

config ESP_HOSTED_WIFI_STATION
	bool "Station mode"

config ESP_HOSTED_WIFI_SOFTAP
	bool "SoftAP mode"

config ESP_HOSTED_WIFI_STATION_SOFTAP
	bool "Station + SoftAP"

endchoice # ESP-Hosted Wi-Fi mode

endif
```

## drivers/wireless/ieee80211/esp_hosted_fg/Kconfig
```kconfig
#
# For a description of the syntax of this configuration file,
# see the file kconfig-language.txt in the NuttX tools repository.
#

config IEEE80211_ESP_HOSTED_FG
	bool
	default n
```
